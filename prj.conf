## CMakeLists.txt
```
# SPDX-License-Identifier: Apache-2.0
if(CONFIG_MM_RADIO)
	file(GLOB app_sources src/*.c)	

	zephyr_sources(${app_sources})
	zephyr_include_directories(include/)
endif()
```

## Kconfig
```
menuconfig MM_RADIO
	bool "Mesomat Radio"
	depends on !BT
	depends on !MPSL
	depends on NRFX_TIMER2
	help
	  Enable the custom mesomat radio protocol.

if MM_RADIO

	
endif # MM_RADIO
```

## prj.conf
```kconfig
CONFIG_NRFX_TIMER2=y
```

## src/main.c
```c
/*
 * Copyright (c) 2016 Intel Corporation
 *
 * SPDX-License-Identifier: Apache-2.0
 */

#include <zephyr/kernel.h>

#include <zephyr/drivers/gpio.h>

#include "radio.h"

K_SEM_DEFINE(test_sem, 0, 1);

static void timer_handler(struct k_timer *timer_id) {
	k_sem_give(&test_sem);
}
K_TIMER_DEFINE(test_timer, timer_handler, NULL);
```

## src/radio.c
```c
/*
 * @Author: alexdr3437 <alexanderdingwall5398@gmail.com>
 * @Date: 2024-02-29 15:32:50
 * @Last Modified by: alexdr3437 <alexanderdingwall5398@gmail.com>
 * @Last Modified time: 2024-02-29 16:10:43
 */

#include <zephyr/logging/log.h>
LOG_MODULE_REGISTER(radio, LOG_LEVEL_DBG);

#include <zephyr/kernel.h>

#include <zephyr/drivers/clock_control.h>
#include <zephyr/drivers/clock_control/nrf_clock_control.h>
#include <zephyr/irq.h>

#include <nrfx.h>

#include "hal/nrf_ficr.h"
#include "hal/nrf_radio.h"

#include "mesomat/radio_events.h"
#include "mesomat/radio_payload.h"
#include "mesomat/radio_slot_operation.h"
#include "mesomat/radio_timer.h"
#include "mesomat/radio.h"

radio_rx_callback_t rx_callback;

enum {
	RECEIVER,
	TRANSMITTER,
};

static int clocks_start(void) {
	int err;
	int res;
	struct onoff_manager *clk_mgr;
	struct onoff_client clk_cli;

	clk_mgr = z_nrf_clock_control_get_onoff(CLOCK_CONTROL_NRF_SUBSYS_HF);
	if (!clk_mgr) {
		LOG_ERR("Unable to get the Clock manager");
		return -ENXIO;
	}

	sys_notify_init_spinwait(&clk_cli.notify);

	err = onoff_request(clk_mgr, &clk_cli);
	if (err < 0) {
		LOG_ERR("Clock request failed: %d", err);
		return err;
	}

	do {
		err = sys_notify_fetch_result(&clk_cli.notify, &res);
		if (!err && res) {
			LOG_ERR("Clock could not be started: %d", res);
			return res;
		}
	} while (err);

	LOG_DBG("HF clock started");
	return 0;
}

static void radio_config() {

	clocks_start();

	nrf_radio_power_set(NRF_RADIO, true);

	nrf_radio_mode_set(NRF_RADIO, RADIO_MODE_MODE_Ble_1Mbit);

	nrf_radio_packet_conf_t config = {
		.lflen		= 0,							// Length on air of LENGTH field in number of bits.
		.s0len		= 0,							// Length on air of S0 field in number of bytes.
		.s1len		= 0,							// Length on air of S1 field in number of bits.
		.s1incl		= RADIO_PCNF0_S1INCL_Automatic, // Include or exclude S1 field in RAM.
		.cilen		= 1,							// Length of code indicator - long range.
		.plen		= RADIO_PCNF0_PLEN_16bit,		// Length of preamble on air. Decision point: TASKS_START task.
		.crcinc		= false,						// Indicates if LENGTH field contains CRC or not.
		.termlen	= 1,							// Length of TERM field in Long Range operation.
		.maxlen		= 255,							// Maximum length of packet payload.
		.statlen	= 255,							// Static length in number of bytes.
		.balen		= 4,							// Base address length in number of bytes.
		.big_endian = false,						// On air endianness of packet.
		.whiteen	= true							// Enable or disable packet whitening.
	};
	nrf_radio_packet_configure(NRF_RADIO, &config);

	nrf_radio_datawhiteiv_set(NRF_RADIO, 0xAB);

	nrf_radio_base0_set(NRF_RADIO, 0xad081c1f);
	nrf_radio_prefix0_set(NRF_RADIO, 0xe7);

	nrf_radio_txaddress_set(NRF_RADIO, 0);
	nrf_radio_rxaddresses_set(NRF_RADIO, 1);

	nrf_radio_crc_configure(NRF_RADIO, 2, RADIO_CRCCNF_SKIP_ADDR_Skip, 0x000AA0AA);
	nrf_radio_crcinit_set(NRF_RADIO, 0x00005050);

	/* nrf_radio_fast_ramp_up_enable_set(NRF_RADIO, false); */

	nrf_radio_txpower_set(NRF_RADIO, RADIO_TXPOWER_TXPOWER_0dBm);
	nrf_radio_frequency_set(NRF_RADIO, 0);

	nrf_radio_shorts_set(NRF_RADIO, NRF_RADIO_SHORT_READY_START_MASK | NRF_RADIO_SHORT_END_DISABLE_MASK | NRF_RADIO_SHORT_ADDRESS_RSSISTART_MASK | NRF_RADIO_SHORT_DISABLED_RSSISTOP_MASK);
}

void radio_register_rx_callback(radio_rx_callback_t callback) {
	rx_callback = callback;
}

int radio_init() {

	radio_config();
	radio_timer_init();

	radio_set_address((radio_address_t *)NRF_FICR->DEVICEADDR);

	return 0;
}
SYS_INIT(radio_init, APPLICATION, CONFIG_APPLICATION_INIT_PRIORITY);
```

## src/radio.h
```c
#ifndef __RADIO_H
#define __RADIO_H

#include <stdint.h>

#include "radio_payload.h"

void radio_set_identity(radio_mode_t mode);
void radio_set_mode(radio_mode_t mode);
void radio_set_advertising_data(const uint8_t *data, uint8_t len);
void radio_pause_advertising(void);
void radio_resume_advertising(void);

#endif
```

## src/radio_events.c
```c
#include <zephyr/logging/log.h>
LOG_MODULE_REGISTER(mm_radio_events, LOG_LEVEL_DBG);

#include <zephyr/kernel.h>

#include <zephyr/init.h>

#include "hal/nrf_radio.h"

#include "mesomat/radio_events.h"
#include "mesomat/radio_payload.h"
#include "mesomat/radio_slot_operation.h"
#include "mesomat/radio_timer.h"

#define RADIO_EVENT_WORK_Q_SIZE 10

K_THREAD_STACK_DEFINE(radio_event_thread_stack, 4096);

K_SEM_DEFINE(radio_end_sem, 0, 1);

struct k_work_q radio_event_work_q;

typedef struct {
	radio_event_t event;
	uint32_t timer_capture;
	struct k_work work;
} event_work_t;
static event_work_t radio_event_work[ RADIO_EVENT_WORK_Q_SIZE ];
int event_work_idx = 0;

void radio_event_wait_for_rx(radio_buffer_t **buffer) {
}

void radio_event_wait_for_tx() {
}

static void radio_event_payload(uint32_t capture) {
}

static void radio_event_ready(uint32_t capture) {
	LOG_DBG("radio ready %d", radio_timer_capture_get(3));
}

radio_handler_t radio_handlers[ N_RADIO_EVENTS ] = {0};

static void radio_event(struct k_work *work) {
	event_work_t *event_work = CONTAINER_OF(work, event_work_t, work);
	radio_event_t event		 = event_work->event;
	uint32_t capture		 = event_work->timer_capture;

	LOG_DBG("radio_event %d %u", event, capture);
	if (radio_handlers[ event ] != NULL) {
		radio_handlers[ event ](capture);
	}
}

void radio_event_handle(radio_event_t event) {
	radio_event_work[ event_work_idx ].timer_capture = radio_timer_capture_get(0);
	radio_event_work[ event_work_idx ].event		 = event;

	int rc		   = k_work_submit_to_queue(&radio_event_work_q, &radio_event_work[ event_work_idx ].work);
	event_work_idx = (event_work_idx + 1) % RADIO_EVENT_WORK_Q_SIZE;
}

void radio_event_register(radio_event_t event, radio_handler_t handler) {
	radio_handlers[ event ] = handler;
}

void radio_isr(void *arg) {

	__disable_irq();

	if (nrf_radio_event_check(NRF_RADIO, NRF_RADIO_EVENT_END)) {
		nrf_radio_event_clear(NRF_RADIO, NRF_RADIO_EVENT_END);
		radio_event_handle(RADIO_EVENT_END);
	}

	if (nrf_radio_event_check(NRF_RADIO, NRF_RADIO_EVENT_READY)) {
		nrf_radio_event_clear(NRF_RADIO, NRF_RADIO_EVENT_READY);
		radio_event_handle(RADIO_EVENT_READY);
	}

	if (nrf_radio_event_check(NRF_RADIO, NRF_RADIO_EVENT_ADDRESS)) {
		nrf_radio_event_clear(NRF_RADIO, NRF_RADIO_EVENT_ADDRESS);
		radio_event_handle(RADIO_EVENT_ADDRESS);
	}

	if (nrf_radio_event_check(NRF_RADIO, NRF_RADIO_EVENT_PAYLOAD)) {
		nrf_radio_event_clear(NRF_RADIO, NRF_RADIO_EVENT_PAYLOAD);
		radio_event_handle(RADIO_EVENT_PAYLOAD);
	}

	if (nrf_radio_event_check(NRF_RADIO, NRF_RADIO_EVENT_DISABLED)) {
		nrf_radio_event_clear(NRF_RADIO, NRF_RADIO_EVENT_DISABLED);
		radio_event_handle(RADIO_EVENT_DISABLED);
	}

	if (nrf_radio_event_check(NRF_RADIO, NRF_RADIO_EVENT_CRCERROR)) {
		nrf_radio_event_clear(NRF_RADIO, NRF_RADIO_EVENT_CRCERROR);
		radio_event_handle(RADIO_EVENT_CRCERROR);
	}

	if (nrf_radio_event_check(NRF_RADIO, NRF_RADIO_EVENT_CRCOK)) {
		nrf_radio_event_clear(NRF_RADIO, NRF_RADIO_EVENT_CRCOK);
		radio_event_handle(RADIO_EVENT_CRCOK);
	}

	if (nrf_radio_event_check(NRF_RADIO, NRF_RADIO_EVENT_TXREADY)) {
		nrf_radio_event_clear(NRF_RADIO, NRF_RADIO_EVENT_TXREADY);
		radio_event_handle(RADIO_EVENT_TXREADY);
	}

	if (nrf_radio_event_check(NRF_RADIO, NRF_RADIO_EVENT_RXREADY)) {
		nrf_radio_event_clear(NRF_RADIO, NRF_RADIO_EVENT_RXREADY);
		radio_event_handle(RADIO_EVENT_RXREADY);
	}

	if (nrf_radio_event_check(NRF_RADIO, NRF_RADIO_EVENT_RSSIEND)) {
		nrf_radio_event_clear(NRF_RADIO, NRF_RADIO_EVENT_RSSIEND);
		radio_event_handle(RADIO_EVENT_RSSIEND);
	}

	__enable_irq();
}

int radio_event_handler_init(void) {
	nrf_radio_int_enable(NRF_RADIO, NRF_RADIO_INT_END_MASK | NRF_RADIO_INT_READY_MASK | NRF_RADIO_INT_ADDRESS_MASK | NRF_RADIO_INT_PAYLOAD_MASK | NRF_RADIO_INT_DISABLED_MASK | NRF_RADIO_INT_CRCERROR_MASK | NRF_RADIO_INT_CRCOK_MASK | NRF_RADIO_INT_TXREADY_MASK | NRF_RADIO_INT_RXREADY_MASK | NRF_RADIO_INT_RSSIEND_MASK);

	IRQ_CONNECT(RADIO_IRQn, 0, radio_isr, NULL, 0);
	irq_enable(RADIO_IRQn);

	const struct k_work_queue_config radio_event_work_q_config = {
		.name	  = "radio_event_work_q",
		.no_yield = false,
	};
	LOG_DBG("radio_event_handler_init\n");

	k_work_queue_init(&radio_event_work_q);
	k_work_queue_start(&radio_event_work_q, radio_event_thread_stack, K_THREAD_STACK_SIZEOF(radio_event_thread_stack), -7, &radio_event_work_q_config);

	for (int i = 0; i < RADIO_EVENT_WORK_Q_SIZE; i++) {
		k_work_init(&radio_event_work[ i ].work, radio_event);
	}
	return 0;
}
SYS_INIT(radio_event_handler_init, APPLICATION, CONFIG_APPLICATION_INIT_PRIORITY);
```

## src/radio_events.h
```c
/**
 * @enum radio_event_t
 * @brief Enumerates the different events that the radio can handle.
 */
typedef enum {
	RADIO_EVENT_READY,
	RADIO_EVENT_END,
	RADIO_EVENT_ADDRESS,
	RADIO_EVENT_PAYLOAD,
	RADIO_EVENT_DISABLED,
	RADIO_EVENT_TXREADY,
	RADIO_EVENT_RXREADY,
	RADIO_EVENT_CRCERROR,
	RADIO_EVENT_CRCOK,
	RADIO_EVENT_PHYEND,
} radio_event_t;

void radio_handle_event(radio_event_t event);
```

## src/radio_operation.c
```c
#include <stdbool.h>
#include <stdint.h>

#include <zephyr/kernel.h>

#define CONFIG_RADIO_OPERATION_STACK_SIZE 4096

K_THREAD_STACK_DEFINE(radio_operation_stack_area, CONFIG_RADIO_OPERATION_STACK_SIZE);
struct k_thread radio_operation_thread_data;

volatile bool terminate;

void radio_operation_start_new_thread(k_thread_entry_t entry) {
	k_thread_create(&radio_operation_thread_data, radio_operation_stack_area, K_THREAD_STACK_SIZEOF(radio_operation_stack_area), entry, &terminate, NULL, NULL, -4, 0, K_NO_WAIT);
}
```

## src/radio_payload.c
```c
#include <zephyr/logging/log.h>
LOG_MODULE_REGISTER(radio_payload, LOG_LEVEL_DBG);

#include <zephyr/kernel.h>

#include <stdint.h>
#include <string.h>

#include "mesomat/radio_payload.h"

#define N_RADIO_BUFFERS 5

static radio_buffer_t outgoing_packet;
static radio_buffer_t radio_buffer[ N_RADIO_BUFFERS ];
static uint8_t radio_buffer_idx = 0;

void radio_set_address(const radio_address_t *address) {
	memcpy(&outgoing_packet.address, address, sizeof(radio_address_t));
}

void radio_descriptor_set_identity(radio_identity_t identity) {
	outgoing_packet.descriptor.identity = identity;
}

void radio_descriptor_set_mode(radio_mode_t mode) {
	outgoing_packet.descriptor.mode = mode;
}

radio_identity_t radio_descriptor_get_identity() {
	return outgoing_packet.descriptor.identity;
}

void radio_payload_set(const uint8_t *data, uint8_t len) {
	outgoing_packet.length = len + (RADIO_MAX_PACKET_LEN - sizeof(outgoing_packet.payload));
	memcpy(outgoing_packet.payload, data, len);
	LOG_HEXDUMP_DBG(outgoing_packet.payload, outgoing_packet.length, "TX payload");
}

radio_buffer_t *radio_payload_get_outgoing() {
	return &outgoing_packet;
}

radio_buffer_t *radio_payload_rx_buffer_get_next() {
	printk("get next\n");
	radio_buffer_idx = (radio_buffer_idx + 1) % N_RADIO_BUFFERS;
	return &radio_buffer[ radio_buffer_idx ];
}

radio_buffer_t *radio_payload_rx_buffer_get_current() {
	printk("get current\n");
	return &radio_buffer[ radio_buffer_idx ];
}
```

## src/radio_payload.h
```c
#ifndef RADIO_PAYLOAD_H__
#define RADIO_PAYLOAD_H__

#include <stdint.h>

#define RADIO_MAX_PAYLOAD_LEN 255

typedef struct {
	uint8_t data[ RADIO_MAX_PAYLOAD_LEN ];
	uint8_t length;
} radio_buffer_t;

#endif
```

## src/radio_scanner.c
```c
#include <zephyr/logging/log.h>
LOG_MODULE_REGISTER(radio_scanner, LOG_LEVEL_DBG);

#include <zephyr/kernel.h>

#include <hal/nrf_radio.h>

#include "mesomat/radio.h"
#include "mesomat/radio_callbacks.h"
#include "mesomat/radio_events.h"

K_SEM_DEFINE(radio_scanner_sem, 0, 1);

static void handle_rx() {
	radio_buffer_t *packet = radio_payload_rx_buffer_get_current();
	LOG_ERR("Rx: got %d bytes, rssi %d", packet->length, -nrf_radio_rssi_sample_get(NRF_RADIO));

	printk("i: %s\n", packet->payload);

	if (rx_callback != NULL) {
		rx_callback(packet->payload, packet->length - (RADIO_MAX_PACKET_LEN - sizeof(packet->payload)), -nrf_radio_rssi_sample_get(NRF_RADIO), packet->descriptor.identity, packet->descriptor.mode);
	}
}

static void handle_crcok_event(uint32_t capture) {
	k_sem_give(&radio_scanner_sem);
}

static void scanner_operation_thread(bool *terminate, void *p2, void *p3) {

	LOG_DBG("Scanner operation thread started");

	for (;;) {
		k_sem_take(&radio_scanner_sem, K_FOREVER);
		if (*terminate) {
			break;
		}

		handle_rx();

		if (*terminate) {
			break;
		}
	}
}

void radio_scanner_start() {
	nrf_radio_task_trigger(NRF_RADIO, NRF_RADIO_TASK_RXEN);
}

void radio_scanner_stop() {
}

void radio_scanner_init() {
	nrf_radio_shorts_set(NRF_RADIO, NRF_RADIO_SHORT_READY_START_MASK | NRF_RADIO_SHORT_END_START_MASK | NRF_RADIO_SHORT_ADDRESS_RSSISTART_MASK | NRF_RADIO_SHORT_DISABLED_RSSISTOP_MASK);
	radio_event_register(RADIO_EVENT_CRCOK, handle_crcok_event);

	radio_operation_start_new_thread(scanner_operation_thread);
}
```

## src/radio_schedule.c
```c
#include <zephyr/logging/log.h>
LOG_MODULE_REGISTER(radio_schedule, LOG_LEVEL_DBG);

#include <stdint.h>

#include "mesomat/radio_schedule.h"

typedef struct {
	uint8_t max_n_slots;
	uint16_t slot_width_ms;
	uint8_t n_slots;
	slot_t slots[ 255 ];
} slot_schedule_t;
static slot_schedule_t slot_schedule;

static uint8_t next_slot_idx = 0;
static uint8_t current_slot	 = 0;

static int insert_slot_sorted(slot_t *slot) {
	slot_schedule.slots[ slot_schedule.n_slots++ ] = *slot;
	return 0;
}

uint32_t get_time_to_slot_start(uint8_t slot, uint8_t current_slot) {
	LOG_DBG("slot %d, current slot %d", slot, current_slot);

	uint32_t time_to_slot_start;
	if (current_slot > slot) {
		time_to_slot_start = (slot_schedule.max_n_slots - current_slot + slot) * slot_schedule.slot_width_ms * 1000;
	} else {
		time_to_slot_start = (slot - current_slot) * slot_schedule.slot_width_ms * 1000;
	}

	return time_to_slot_start;
}

slot_t *radio_schedule_get_next_slot() {
	return &slot_schedule.slots[ next_slot_idx ];
}

uint8_t radio_schedule_get_current_slot() {
	return current_slot;
}

void radio_schedule_advance_slot() {
	current_slot  = slot_schedule.slots[ next_slot_idx ].slot;
	next_slot_idx = (next_slot_idx + 1) % slot_schedule.n_slots;
}

void radio_schedule_init(uint8_t max_n_slots, uint16_t slot_width_ms) {
	slot_schedule = (slot_schedule_t){
		.max_n_slots   = max_n_slots,
		.slot_width_ms = slot_width_ms,
		.n_slots	   = 0,
	};
}

int radio_schedule_timeslot_add(slot_type_t slot_type, uint8_t channel, uint8_t slot) {
	if (slot_schedule.n_slots >= slot_schedule.max_n_slots) {
		return -1;
	}
	slot_t s = {
		.slot_type = slot_type,
		.channel   = channel,
		.slot	   = slot,
	};
	insert_slot_sorted(&s);

	return 0;
}

void radio_timeslot_print_schedule() {
	for (int i = 0; i < slot_schedule.n_slots; i++) {
		LOG_INF("slot %d: type %s, channel %d, slot %d", i, slot_schedule.slots[ i ].slot_type == SLOT_TYPE_RX ? "Rx" : "Tx", slot_schedule.slots[ i ].channel, slot_schedule.slots[ i ].slot);
	}
}
```

## src/radio_slot_operation.c
```c
/*
 * @Author: alexdr3437 <alexanderdingwall5398@gmail.com>
 * @Date: 2024-02-29 15:54:03
 * @Last Modified by: alexdr3437 <alexanderdingwall5398@gmail.com>
 * @Last Modified time: 2024-02-29 16:47:13
 */

#include <zephyr/logging/log.h>
LOG_MODULE_REGISTER(radio_timeslotting, LOG_LEVEL_DBG);

#include <zephyr/kernel.h>

#include <stdbool.h>
#include <stdint.h>

#include <hal/nrf_radio.h>

#include "mesomat/radio.h"
#include "mesomat/radio_callbacks.h"
#include "mesomat/radio_events.h"
#include "mesomat/radio_payload.h"
#include "mesomat/radio_schedule.h"
#include "mesomat/radio_slot_operation.h"
#include "mesomat/radio_timer.h"

#define NOMINAL_TX_OFFSET_us 55	  // measured empirically, time between Tx READY and ADDRESS events
#define MAX_TRANSFER_TIME_us 4508 // measured empirically, amount of time for a maximum length packet to be transmitted, (between Tx READY and END events)
#define GUARD_TIME_us		 1000
#define MAX_RX_TIME_us		 (2 * (GUARD_TIME_us) + MAX_TRANSFER_TIME_us)

static uint32_t last_timeslot_start = 0;
static bool is_initiator			= false;
static bool is_initiated			= false;
static bool trigger_disable_flag	= false;
static bool rx_flag					= false;

K_SEM_DEFINE(timeslot_operation_start_sem, 0, 1);
K_SEM_DEFINE(got_rx_message_sem, 0, 1);

K_MUTEX_DEFINE(slot_end_mut);
K_CONDVAR_DEFINE(slot_end_var);

static void wait_for_initiation() {

	nrf_radio_packetptr_set(NRF_RADIO, (void *)radio_payload_get_outgoing());

	for (;;) {
		nrf_radio_task_trigger(NRF_RADIO, NRF_RADIO_TASK_RXEN);
		k_sem_take(&got_rx_message_sem, K_FOREVER);

		radio_buffer_t *rx_payload = (radio_buffer_t *)nrf_radio_packetptr_get(NRF_RADIO);

		LOG_HEXDUMP_DBG(rx_payload, 2 + rx_payload->length, "payload");

		if (rx_payload->descriptor.identity == RADIO_IDENTITY_GATEWAY && rx_payload->descriptor.mode == RADIO_MODE_MESH) {
			LOG_DBG("Got initiation message");
			break;
		}
	}
}

static void slot_end_timeout_handler(struct k_timer *timer) {
	LOG_DBG("ended at %u", radio_timer_now());
	if (trigger_disable_flag) {
		nrf_radio_task_trigger(NRF_RADIO, NRF_RADIO_TASK_DISABLE);
	}
}
K_TIMER_DEFINE(slot_end_timer, slot_end_timeout_handler, NULL);

void radio_timeslot_end_event(uint32_t capture) {
}

void radio_timeslot_disabled_event(uint32_t capture) {
	LOG_DBG("timeslot end event at %u", capture);
	trigger_disable_flag = false;
	k_timer_stop(&slot_end_timer);
	k_condvar_broadcast(&slot_end_var);
}

void radio_timeslot_address_event(uint32_t capture) {
	static uint32_t last_capture = 0;
	if (!is_initiated) {
		last_timeslot_start = capture - NOMINAL_TX_OFFSET_us;
	} else {
		LOG_DBG("address event %u", capture - last_capture);
		last_capture = capture;
	}
}

void radio_timeslot_crcok_event(uint32_t capture) {
	rx_flag = true;
	k_sem_give(&got_rx_message_sem);
}

void radio_timeslot_rssiend_event(uint32_t capture) {
}

static inline void wait_for_slot_end() {
	LOG_DBG("Waiting for slot end");
	k_condvar_wait(&slot_end_var, &slot_end_mut, K_FOREVER);
}

static void handle_rx() {
	LOG_DBG("Handling RX");

	if (rx_flag) {
		radio_buffer_t *packet = radio_payload_rx_buffer_get_current();
		LOG_ERR("Rx: got %d bytes, rssi %d", packet->length, -nrf_radio_rssi_sample_get(NRF_RADIO));

		printk("i: %s\n", packet->payload);

		if (rx_callback != NULL) {
			rx_callback(packet->payload, packet->length - (RADIO_MAX_PACKET_LEN - sizeof(packet->payload)), -nrf_radio_rssi_sample_get(NRF_RADIO), packet->descriptor.identity, packet->descriptor.mode);
		}

		packet = radio_payload_get_outgoing();
		printk("o: %s\n", packet->payload);

	} else {
		LOG_DBG("Rx: no message");
	}

	rx_flag = false;
}

static void timeslot_rx(slot_t *slot, uint8_t current_slot) {
	LOG_DBG("RX slot %d, current slot %d", slot->slot, current_slot);
	uint32_t time_until_slot_start = get_time_to_slot_start(slot->slot, current_slot);

	nrf_radio_packetptr_set(NRF_RADIO, (void *)radio_payload_rx_buffer_get_next());

	radio_timer_schedule_next_slot_start(time_until_slot_start, last_timeslot_start);
	last_timeslot_start = radio_timer_schedule_next_rx(time_until_slot_start - GUARD_TIME_us, last_timeslot_start) + GUARD_TIME_us;

	trigger_disable_flag = true;
	rx_flag				 = false;
	k_timer_start(&slot_end_timer, K_USEC(time_until_slot_start + MAX_RX_TIME_us - GUARD_TIME_us), K_NO_WAIT);
}

static void timeslot_tx(slot_t *slot, uint8_t current_slot) {
	LOG_DBG("TX slot %d, channel %d, current slot %d", slot->slot, slot->channel, current_slot);
	uint32_t time_until_slot_start = get_time_to_slot_start(slot->slot, current_slot);

	nrf_radio_packetptr_set(NRF_RADIO, (void *)radio_payload_get_outgoing());

	radio_timer_schedule_next_slot_start(time_until_slot_start, last_timeslot_start);
	last_timeslot_start = radio_timer_schedule_next_tx(time_until_slot_start, last_timeslot_start);

	LOG_DBG("time_until_slot_start: %u, last_timeslot_start: %u", time_until_slot_start, last_timeslot_start);
}

static void radio_timeslot_operation_thread(bool *terminate, void *p2, void *p3) {
	k_sem_take(&timeslot_operation_start_sem, K_FOREVER);

	if (!is_initiator) {
		LOG_DBG("Waiting for initiation");
		wait_for_initiation();
	} else {
		is_initiated		= true;
		last_timeslot_start = radio_timer_now();
		LOG_INF("Initiator, last_timeslot_start: %u", last_timeslot_start);
	}

	LOG_DBG("Starting timeslot operation");

	for (;;) {
		slot_t *slot		 = radio_schedule_get_next_slot();
		uint8_t current_slot = radio_schedule_get_current_slot();
		if (slot->slot != radio_schedule_get_current_slot()) {
			LOG_ERR("current_slot_idx: %d, time: %u", current_slot, radio_timer_now());

			nrf_radio_frequency_set(NRF_RADIO, slot->channel);

			if (slot->slot_type == SLOT_TYPE_RX) {
				timeslot_rx(slot, current_slot);
			} else {
				timeslot_tx(slot, current_slot);
			}

			wait_for_slot_end();

			if (slot->slot_type == SLOT_TYPE_RX) {
				handle_rx();
			}
		}
		radio_schedule_advance_slot();
	}
}

void radio_timeslot_operation_start() {
	radio_event_register(RADIO_EVENT_DISABLED, radio_timeslot_disabled_event);
	radio_event_register(RADIO_EVENT_ADDRESS, radio_timeslot_address_event);
	radio_event_register(RADIO_EVENT_CRCOK, radio_timeslot_crcok_event);
	radio_event_register(RADIO_EVENT_RSSIEND, radio_timeslot_rssiend_event);

	nrf_radio_shorts_set(NRF_RADIO, NRF_RADIO_SHORT_READY_START_MASK | NRF_RADIO_SHORT_END_DISABLE_MASK | NRF_RADIO_SHORT_ADDRESS_RSSISTART_MASK | NRF_RADIO_SHORT_DISABLED_RSSISTOP_MASK);

	LOG_DBG("Starting timeslot operation");
	is_initiator = radio_descriptor_get_identity() == RADIO_IDENTITY_GATEWAY;

	
}
```

## src/radio_slot_operation.h
```c
#ifndef RADIO_TIMESLOTTING_H__
#define RADIO_TIMESLOTTING_H__

#include <stdbool.h>
#include <stdint.h>

#include "radio_payload.h"

typedef enum {
	SLOT_TYPE_TX,
	SLOT_TYPE_RX,
	SLOT_TYPE_BROADCAST,
} slot_type_t;

typedef void (*radio_rx_callback_t)(uint8_t *data, uint8_t len, int8_t rssi, radio_identity_t identity, radio_mode_t mode);
void radio_register_rx_callback(radio_rx_callback_t callback);

void radio_schedule_init(uint8_t max_n_slots, uint16_t slot_width_ms);
int radio_schedule_timeslot_add(slot_type_t slot_type, uint8_t channel, uint8_t slot);
void radio_timeslot_print_schedule();

void radio_timeslot_operation_start();
void radio_timeslot_end_event(uint32_t capture);
void radio_timeslot_disabled_event(uint32_t capture);
void radio_timeslot_address_event(uint32_t capture);
void radio_timeslot_crcok_event(uint32_t capture);
void radio_timeslot_rssiend_event(uint32_t capture);

#endif
```

## src/radio_timer.c
```c
/*
 * @Author: alexdr3437 <alexanderdingwall5398@gmail.com>
 * @Date: 2024-02-29 15:33:03
 * @Last Modified by: alexdr3437 <alexanderdingwall5398@gmail.com>
 * @Last Modified time: 2024-02-29 15:33:08
 */

#include <zephyr/logging/log.h>
LOG_MODULE_REGISTER(radio_timer, LOG_LEVEL_WRN);

#include <zephyr/kernel.h>

#include <hal/nrf_radio.h>
#include <nrfx.h>
#include <nrfx_gpiote.h>
#include <nrfx_ppi.h>
#include <nrfx_timer.h>

#include "mesomat/radio_timer.h"

#define OUTPUT_PIN 14

static nrf_ppi_channel_t ppi_channels[ 6 ];

const nrfx_timer_t timer = {
	.p_reg			  = NRF_TIMER2,
	.instance_id	  = NRFX_TIMER2_INST_IDX,
	.cc_channel_count = TIMER2_CC_NUM,
};

int radio_timer_init(void) {
	int rc;

	static nrfx_timer_config_t timer_config = {
		.frequency			= 1000000,
		.mode				= NRF_TIMER_MODE_TIMER,
		.bit_width			= NRF_TIMER_BIT_WIDTH_32,
		.interrupt_priority = 7,
		.p_context			= NULL,
	};

	uint8_t out_channel;
	rc = nrfx_gpiote_channel_alloc(&out_channel);
	if (rc != NRFX_SUCCESS) {
		LOG_ERR("Failed to allocate GPIOTE channel %08x", rc);
		return -EINVAL;
	}

	const nrfx_gpiote_output_config_t output_config = {
		.drive		   = NRF_GPIO_PIN_S0S1,
		.input_connect = NRF_GPIO_PIN_INPUT_DISCONNECT,
		.pull		   = NRF_GPIO_PIN_NOPULL,
	};

	const nrfx_gpiote_task_config_t task_config = {
		.task_ch  = out_channel,
		.polarity = NRF_GPIOTE_POLARITY_TOGGLE,
		.init_val = NRF_GPIOTE_INITIAL_VALUE_HIGH,
	};

	rc = nrfx_gpiote_output_configure(OUTPUT_PIN, &output_config, &task_config);
	if (rc != NRFX_SUCCESS) {
		LOG_ERR("Failed to configure GPIOTE output");
		return -EINVAL;
	}

	nrfx_gpiote_out_task_enable(OUTPUT_PIN);

	rc = nrfx_timer_init(&timer, &timer_config, NULL);
	if (rc != NRFX_SUCCESS) {
		LOG_ERR("Failed to initialize timer %08x", rc);
		return -EINVAL;
	}

	for (int i = 0; i < ARRAY_SIZE(ppi_channels); i++) {
		rc = nrfx_ppi_channel_alloc(&ppi_channels[ i ]);
		if (rc != NRFX_SUCCESS) {
			LOG_ERR("Failed to allocate PPI channel");
			return -EINVAL;
		}
	}

	rc = nrfx_ppi_channel_assign(ppi_channels[ 0 ], nrf_radio_event_address_get(NRF_RADIO, NRF_RADIO_EVENT_ADDRESS), nrfx_timer_capture_task_address_get(&timer, NRF_TIMER_CC_CHANNEL0));
	if (rc != NRFX_SUCCESS) {
		LOG_ERR("Failed to assign PPI channel");
		return -EINVAL;
	}

	rc = nrfx_ppi_channel_assign(ppi_channels[ 4 ], nrf_radio_event_address_get(NRF_RADIO, NRF_RADIO_EVENT_READY), nrfx_timer_capture_task_address_get(&timer, NRF_TIMER_CC_CHANNEL0));
	if (rc != NRFX_SUCCESS) {
		LOG_ERR("Failed to assign PPI channel");
		return -EINVAL;
	}

	rc = nrfx_ppi_channel_assign(ppi_channels[ 5 ], nrf_radio_event_address_get(NRF_RADIO, NRF_RADIO_EVENT_END), nrfx_timer_capture_task_address_get(&timer, NRF_TIMER_CC_CHANNEL0));
	if (rc != NRFX_SUCCESS) {
		LOG_ERR("Failed to assign PPI channel");
		return -EINVAL;
	}

	rc = nrfx_ppi_channel_assign(ppi_channels[ 1 ], nrf_timer_event_address_get(timer.p_reg, NRF_TIMER_EVENT_COMPARE1), nrf_radio_task_address_get(NRF_RADIO, NRF_RADIO_TASK_RXEN));
	if (rc != NRFX_SUCCESS) {
		LOG_ERR("Failed to assign PPI channel");
		return -EINVAL;
	}

	rc = nrfx_ppi_channel_assign(ppi_channels[ 2 ], nrf_timer_event_address_get(timer.p_reg, NRF_TIMER_EVENT_COMPARE2), nrf_radio_task_address_get(NRF_RADIO, NRF_RADIO_TASK_TXEN));
	if (rc != NRFX_SUCCESS) {
		LOG_ERR("Failed to assign PPI channel");
		return -EINVAL;
	}

	/* rc = nrfx_ppi_channel_assign(ppi_channels[ 3 ], nrf_timer_event_address_get(timer.p_reg, NRF_TIMER_EVENT_COMPARE3), nrfx_gpiote_out_task_address_get(OUTPUT_PIN)); */
	/* if (rc != NRFX_SUCCESS) { */
	/* 	LOG_ERR("Failed to assign PPI channel"); */
	/* 	return -EINVAL; */
	/* } */

	for (int i = 0; i < ARRAY_SIZE(ppi_channels); i++) {
		rc = nrfx_ppi_channel_enable(ppi_channels[ i ]);
		if (rc != NRFX_SUCCESS) {
			LOG_ERR("Failed to enable PPI channel");
			return -EINVAL;
		}
	}

	LOG_INF("Radio timer initialized");
	nrfx_timer_resume(&timer);

	nrfx_timer_compare(&timer, NRF_TIMER_CC_CHANNEL3, 1000000, false);

	return 0;
}

uint32_t radio_timer_schedule_next_rx(uint32_t start, uint32_t datum) {
	uint32_t cmp_value;
	cmp_value = datum + start;
	nrfx_timer_compare(&timer, NRF_TIMER_CC_CHANNEL1, cmp_value, false);
	return cmp_value;
}
uint32_t radio_timer_schedule_next_tx(uint32_t start, uint32_t datum) {
	uint32_t cmp_value;
	cmp_value = datum + start;
	nrfx_timer_compare(&timer, NRF_TIMER_CC_CHANNEL2, cmp_value, false);
	return cmp_value;
}
uint32_t radio_timer_schedule_next_slot_start(uint32_t start, uint32_t datum) {
	uint32_t cmp_value;
	cmp_value = datum + start;
	nrfx_timer_compare(&timer, NRF_TIMER_CC_CHANNEL3, cmp_value, false);
	return cmp_value;
}
```
